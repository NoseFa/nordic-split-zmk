## boards/shields/nordic1/Kconfig.defconfig
```kconfig
if SHIELD_NORDIC1_LEFT

config ZMK_KEYBOARD_NAME
    default "Nordic_Split"

config ZMK_SPLIT_ROLE_CENTRAL
    default y

endif # SHIELD_NORDIC1_LEFT

if SHIELD_NORDIC1_LEFT || SHIELD_NORDIC1_RIGHT

config ZMK_SPLIT
    default y

endif # SHIELD_NORDIC1_LEFT || SHIELD_NORDIC1_RIGHT
```

## boards/shields/nordic1/Kconfig.shield
```kconfig
config SHIELD_NORDIC1_LEFT
    def_bool $(shields_list_contains,nordic1_left)

config SHIELD_NORDIC1_RIGHT
    def_bool $(shields_list_contains,nordic1_right)
```
